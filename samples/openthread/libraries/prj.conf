## CMakeLists.txt
```
#
# Copyright (c) 2020 Nordic Semiconductor ASA
#
# SPDX-License-Identifier: LicenseRef-BSD-5-Clause-Nordic
#
cmake_minimum_required(VERSION 3.13.1)

include($ENV{ZEPHYR_BASE}/cmake/app/boilerplate.cmake NO_POLICY_SCOPE)
project(NONE)

FILE(GLOB app_sources src/*.c)

target_sources(app PRIVATE ${app_sources})

execute_process(
  COMMAND           git rev-parse HEAD
  WORKING_DIRECTORY ${openthread_SOURCE_DIR}
  RESULT_VARIABLE   git_return
  OUTPUT_VARIABLE   openthread_git_hash)

list(APPEND OT_SETTINGS "OpenThread_commit=${openthread_git_hash}\n\n")

# Store all OT related variables
get_cmake_property(_variableNames VARIABLES)
list (SORT _variableNames)
foreach (_variableName ${_variableNames})
    if("${_variableName}" MATCHES "^CONFIG_OPENTHREAD_.*|^OT_.*") 
	    list(APPEND OT_SETTINGS "${_variableName}=${${_variableName}}\n")
    endif()
endforeach()

FILE(WRITE "${NRFXLIB_DIR}/openthread/openthread_lib_configuration.txt" ${OT_SETTINGS})

set(OPENTHREAD_LIBS
	"${PROJECT_BINARY_DIR}/modules/openthread/build/src/core/libopenthread-ftd.a"
	"${PROJECT_BINARY_DIR}/modules/openthread/build/src/core/libopenthread-mtd.a"
	"${PROJECT_BINARY_DIR}/modules/openthread/build/src/core/libopenthread-radio.a"
	"${PROJECT_BINARY_DIR}/modules/openthread/build/src/cli/libopenthread-cli-ftd.a"
	"${PROJECT_BINARY_DIR}/modules/openthread/build/src/cli/libopenthread-cli-mtd.a"
	"${PROJECT_BINARY_DIR}/modules/openthread/build/src/ncp/libopenthread-ncp-ftd.a"
	"${PROJECT_BINARY_DIR}/modules/openthread/build/src/ncp/libopenthread-ncp-mtd.a"
	"${PROJECT_BINARY_DIR}/modules/openthread/build/src/ncp/libopenthread-rcp.a"
)

message(STATUS "OPENTHREAD_LIBS=${OPENTHREAD_LIBS}")

#TODO: is it true?
if(CONFIG_CPU_HAS_FPU)
	set(FLOAT_VARIANT "hard-float")
else()
	set(FLOAT_VARIANT "soft-float")
endif()

foreach(lib IN LISTS OPENTHREAD_LIBS)
    add_custom_command(
		TARGET app POST_BUILD
                COMMAND ${CMAKE_COMMAND} -E copy "${lib}" "${NRFXLIB_DIR}/openthread/lib/${GCC_M_CPU}/${FLOAT_VARIANT}/v${OT_THREAD_VERSION}"
		COMMAND echo "Copying library: ${lib}"
		DEPENDS ${OPENTHREAD_LIBS})
endforeach()

file(COPY "${openthread_SOURCE_DIR}/include" 
	DESTINATION "${NRFXLIB_DIR}/openthread/"
	FILES_MATCHING PATTERN "*[!android].h")

file(COPY "${openthread_SOURCE_DIR}/examples/platforms/openthread-system.h" 
	DESTINATION "${NRFXLIB_DIR}/openthread/lib/${GCC_M_CPU}/${FLOAT_VARIANT}/v${OT_THREAD_VERSION}/include/"
	FILES_MATCHING PATTERN "*[!android].h")

message(STATUS "OT source dir=${openthread_SOURCE_DIR}")
message(STATUS "OT_LIB destination dir=${NRFXLIB_DIR}/openthread/lib/${GCC_M_CPU}/${FLOAT_VARIANT}/v${OT_THREAD_VERSION}")
```

## Kconfig
```
#
# Copyright (c) 2020 Nordic Semiconductor ASA
#
# SPDX-License-Identifier: LicenseRef-BSD-5-Clause-Nordic
#

menu "Zephyr Kernel"
source "Kconfig.zephyr"
endmenu

module = OT_LIB
module-str = ot_lib
source "${ZEPHYR_BASE}/subsys/logging/Kconfig.template.log_config"
```

## sample.yaml
```
sample:
  description: Build and substitute OpenThread library.
  name: OpenThread Libraries sample
tests:
  samples.openthread.lib:
    build_only: true
    build_on_all: true
    tags: openthread lib
    platform_whitelist: nrf52840dk_nrf52840 nrf52833dk_nrf52833
```

## prj.conf
```kconfig
#
# Copyright (c) 2020 Nordic Semiconductor
#
# SPDX-License-Identifier: LicenseRef-BSD-5-Clause-Nordic
#
CONFIG_NEWLIB_LIBC=y
CONFIG_ENTROPY_CC310=n

# Generic networking options
CONFIG_NETWORKING=y
CONFIG_NET_UDP=y
CONFIG_NET_IPV6=y
CONFIG_NET_CONNECTION_MANAGER=y

# Kernel options
CONFIG_MAIN_STACK_SIZE=2048
CONFIG_ENTROPY_GENERATOR=y
CONFIG_INIT_STACKS=y

# Logging
CONFIG_NET_LOG=y
CONFIG_LOG=y
CONFIG_NET_STATISTICS=y
CONFIG_PRINTK=y
CONFIG_NET_CONFIG_LOG_LEVEL_INF=y

# Network shell
CONFIG_NET_SHELL=y

CONFIG_SHELL_ARGC_MAX=26
CONFIG_SHELL_CMD_BUFF_SIZE=416

CONFIG_CPLUSPLUS=y

CONFIG_NET_CONFIG_SETTINGS=y
CONFIG_NET_IPV6_NBR_CACHE=n
CONFIG_NET_IPV6_MLD=n
CONFIG_NET_CONFIG_NEED_IPV6=y
CONFIG_NET_CONFIG_INIT_TIMEOUT=0

CONFIG_SYSTEM_WORKQUEUE_STACK_SIZE=2048
CONFIG_NET_TX_STACK_SIZE=2048
CONFIG_SHELL_STACK_SIZE=3072

CONFIG_NET_L2_OPENTHREAD=y

CONFIG_OPENTHREAD_DEBUG=y
CONFIG_OPENTHREAD_L2_DEBUG=y
CONFIG_OPENTHREAD_L2_LOG_LEVEL_INF=y

CONFIG_OPENTHREAD_CHANNEL=11
CONFIG_OPENTHREAD_THREAD_PREEMPTIVE=y

# Enable joiner and commissioner optional features
CONFIG_OPENTHREAD_COMMISSIONER=y
CONFIG_OPENTHREAD_JOINER=y
CONFIG_MBEDTLS_HEAP_SIZE=10240

# Other optional OpenThread features
CONFIG_OPENTHREAD_DHCP6_CLIENT=y
CONFIG_OPENTHREAD_SLAAC=y
CONFIG_OPENTHREAD_BORDER_ROUTER=y

# Thread by default registers quite a lot addresses.
CONFIG_NET_IF_UNICAST_IPV6_ADDR_COUNT=6
CONFIG_NET_IF_MCAST_IPV6_ADDR_COUNT=8

# Other OpenThread dependencies
CONFIG_FLASH=y
CONFIG_FLASH_PAGE_LAYOUT=y
CONFIG_FLASH_MAP=y
CONFIG_MPU_ALLOW_FLASH_WRITE=y
CONFIG_NVS=y
CONFIG_SETTINGS=y

CONFIG_REBOOT=y
```

## src/main.c
```c
/*
 * Copyright (c) 2020 Nordic Semiconductor ASA
 *
 * SPDX-License-Identifier: LicenseRef-BSD-5-Clause-Nordic
 */

void main(void)
{
	// Intentionally empty.
}
```
